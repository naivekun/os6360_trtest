## cpss-ac3/lsp/wnc_tools/wnc-its/wnc-diag-sha.its
```
/*
 * U-boot uImage source file with multiple kernels, ramdisks and FDT blobs
 */

/dts-v1/;

/ {
	description = "Various kernels, ramdisks and FDT blobs";
	#address-cells = <1>;

	images {
		kernel@1 {
			description = "Quagga Linux Kernel 4.4";
			data = /incbin/("./zImage");
			type = "kernel";
			arch = "arm";
			os = "linux";
			compression = "none";
			load = <0x00008000>;
			entry = <0x00008000>;
                        hash@1 {
                        algo = "sha1";
                        };
		};

		ramdisk@1 {
			description = "Quagga Initramfs";
			data = /incbin/("./ramdisk.cpio.gz");
			type = "ramdisk";
			arch = "arm";
			os = "linux";
			compression = "gzip";
			load = <0x00000000>;
			entry = <0x00000000>;
                        hash@1 {
                        algo = "sha1";
                        };
		};

		fdt@1 {
			description = "Quagga device tree";
			data = /incbin/("./msys-ac3-meraki.dtb");
			type = "flat_dt";
			arch = "arm";
			compression = "none";
                        hash@1 {
                        algo = "sha1";
                        };
		};
	};

	configurations {
		default = "config@1";

		config@1 {
			description = "Quagga images tree";
			kernel = "kernel@1";
			ramdisk = "ramdisk@1";
			fdt = "fdt@1";
		};
	};
};
```

## cpss-ac3/lsp/wnc_tools/wnc-its/wnc-diag.its
```
/*
 * U-boot uImage source file with multiple kernels, ramdisks and FDT blobs
 */

/dts-v1/;

/ {
	description = "Various kernels, ramdisks and FDT blobs";
	#address-cells = <1>;

	images {
		kernel@1 {
			description = "OS6360 Linux Kernel 4.4";
			data = /incbin/("./zImage");
			type = "kernel";
			arch = "arm";
			os = "linux";
			compression = "none";
			load = <0x00008000>;
			entry = <0x00008000>;
		};

		ramdisk@1 {
			description = "OS6360 Initramfs";
			data = /incbin/("./ramdisk.cpio.gz");
			type = "ramdisk";
			arch = "arm";
			os = "linux";
			compression = "gzip";
			load = <0x00000000>;
			entry = <0x00000000>;
		};

		fdt@1 {
			description = "OS6360 device tree";
			data = /incbin/("./msys-ac3-rd.dtb");
			type = "flat_dt";
			arch = "arm";
			compression = "none";
		};
	};

	configurations {
		default = "config@1";

		config@1 {
			description = "OS6360 images tree";
			kernel = "kernel@1";
			ramdisk = "ramdisk@1";
			fdt = "fdt@1";
		};
	};
};
```
